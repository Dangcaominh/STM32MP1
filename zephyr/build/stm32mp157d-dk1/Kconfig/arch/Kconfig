## zephyr/build/stm32mp157d-dk1/Kconfig/arch/Kconfig
```kconfig
# Load Zephyr Arch Kconfig descriptions.
osource "/home/dangcaominh/STM32MP1/zephyr/arch/rx/Kconfig"
osource "/home/dangcaominh/STM32MP1/zephyr/arch/x86/Kconfig"
osource "/home/dangcaominh/STM32MP1/zephyr/arch/xtensa/Kconfig"
osource "/home/dangcaominh/STM32MP1/zephyr/arch/sparc/Kconfig"
osource "/home/dangcaominh/STM32MP1/zephyr/arch/riscv/Kconfig"
osource "/home/dangcaominh/STM32MP1/zephyr/arch/posix/Kconfig"
osource "/home/dangcaominh/STM32MP1/zephyr/arch/mips/Kconfig"
osource "/home/dangcaominh/STM32MP1/zephyr/arch/arm64/Kconfig"
osource "/home/dangcaominh/STM32MP1/zephyr/arch/arm/Kconfig"
osource "/home/dangcaominh/STM32MP1/zephyr/arch/arc/Kconfig"
```

## zephyr/build/stm32mp157d-dk1/Kconfig/boards/Kconfig.defconfig
```kconfig
# Load Zephyr board defconfig descriptions.
osource "/home/dangcaominh/STM32MP1/zephyr/boards/st/stm32mp157c_dk2/Kconfig.defconfig"
```

## zephyr/build/stm32mp157d-dk1/Kconfig/boards/Kconfig.stm32mp157c_dk2
```kconfig
# Load board Kconfig descriptions.
osource "/home/dangcaominh/STM32MP1/zephyr/boards/st/stm32mp157c_dk2/Kconfig.stm32mp157c_dk2"
```

## zephyr/build/stm32mp157d-dk1/Kconfig/boards/Kconfig.sysbuild
```kconfig
# Load Sysbuild board Kconfig descriptions.
osource "/home/dangcaominh/STM32MP1/zephyr/boards/st/stm32mp157c_dk2/Kconfig.sysbuild"
```
